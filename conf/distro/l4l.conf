## conf/distro/l4l.conf
```bitbake
DISTRO = "l4l"
DISTRO_NAME = "LoRa for Linux"
DISTRO_VERSION = "0.0.0"
DISTRO_CODENAME = "devel"

MAINTAINER = "Jean-Marie Lemetayer <jeanmarie.lemetayer@gmail.com>"

INIT_MANAGER = "systemd"

DISTRO_FEATURES = "${DISTRO_FEATURES_DEFAULT}"

DISTRO_EXTRA_RDEPENDS = " \
    l4l-modules \
"
```

## conf/layer.conf
```bitbake
# We have a conf and classes directory, add to BBPATH
BBPATH .= ":${LAYERDIR}"

# We have recipes-* directories, add to BBFILES
BBFILES += "${LAYERDIR}/recipes-*/*/*.bb \
            ${LAYERDIR}/recipes-*/*/*.bbappend"

BBFILE_COLLECTIONS += "meta-lora4linux"
BBFILE_PATTERN_meta-lora4linux = "^${LAYERDIR}/"
BBFILE_PRIORITY_meta-lora4linux = "6"

LAYERDEPENDS_meta-lora4linux = "core"
LAYERSERIES_COMPAT_meta-lora4linux = "walnascar"
```
